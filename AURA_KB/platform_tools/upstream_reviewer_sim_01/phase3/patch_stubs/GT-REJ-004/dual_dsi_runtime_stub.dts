/* Phase 3 stub - constructed from patch metadata, not real patch content */
/dts-v1/;

/ {
    model = "qcom-db845c-dual-dsi-stub";

    panel@0 {
        status = "okay";
        dsi-link = <0 1>;
    };
};
